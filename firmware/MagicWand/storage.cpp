#include "storage.h"

#include <Arduino.h>
#include <stddef.h>
#include <string.h>

#if STORAGE_NVM3
#include "nvm3_default.h"  // Silicon Labs NVM3 (part of the core's SDK)
#else
#include <EEPROM.h>
#endif

Settings settings;
wand::GestureSlot gestures[wand::kMaxGestures];
IrCode codes[IR_MAX_CODES];

namespace storage {

static const uint32_t kMagic = 0x57414E44;  // "WAND"
static const uint16_t kVersion = 3;  // 3: IR codes stored decoded (hex + timings)
static uint32_t err = 0;

static void defaults() {
  memset(&settings, 0, sizeof(settings));
  settings.magic = kMagic;
  settings.version = kVersion;
  settings.wakeThreshold = WAKE_THRESHOLD;
  settings.hapticsOn = 1;
  settings.axis[0] = WAND_AXIS_X;
  settings.axis[1] = WAND_AXIS_Y;
  settings.axis[2] = WAND_AXIS_Z;
  settings.threshold = GLOBAL_THRESHOLD;
  settings.idleSleepMs = IDLE_SLEEP_MS;
  memset(settings.bind, kNoBinding, sizeof(settings.bind));
}

// Bytes of a gesture/code that are actually used.
static size_t gestureBytes(const wand::GestureSlot& g) {
  return offsetof(wand::GestureSlot, samples) + g.count * sizeof(wand::Template);
}
static size_t codeBytes(const IrCode&) { return sizeof(IrCode); }
static bool codeValid(const IrCode& c) {
  return c.khz >= 20 && c.khz <= 60 && c.nbits > 0 && c.nbits <= IR_MAX_BYTES * 8 && c.repeats >= 1 &&
         c.repeats <= IR_MAX_REPEATS && c.one > 0 && c.zero > 0 && c.bitMark > 0;
}

uint32_t lastError() { return err; }

// ------------------------------------------------------------------ factory content
// default_spells.h holds raw copies of GestureSlot / IrCode structs (only the
// used bytes), exactly as the EXPORT command prints them.
struct DefaultItem {
  uint8_t slot;
  const uint8_t* data;
  uint16_t len;
};
#include "default_spells.h"

// Put the factory spells/codes/bindings into RAM (caller saves).
static void loadFactoryContent() {
#if DEFAULT_GESTURES > 0
  for (const DefaultItem& d : kDefaultGestureList) {
    if (d.slot >= wand::kMaxGestures || d.len > sizeof(wand::GestureSlot)) continue;
    memset(&gestures[d.slot], 0, sizeof(wand::GestureSlot));
    memcpy(&gestures[d.slot], d.data, d.len);
  }
#endif
#if DEFAULT_CODES > 0
  for (const DefaultItem& d : kDefaultCodeList) {
    if (d.slot >= IR_MAX_CODES || d.len > sizeof(IrCode)) continue;
    memset(&codes[d.slot], 0, sizeof(IrCode));
    memcpy(&codes[d.slot], d.data, d.len);
  }
#endif
  memcpy(settings.bind, kDefaultBind, sizeof(settings.bind));
}

static void emitBytes(void (*emit)(const char*), const char* var, const uint8_t* p, size_t n) {
  char line[120];
  snprintf(line, sizeof(line), "static const uint8_t %s[] = {", var);
  emit(line);
  for (size_t i = 0; i < n; i += 16) {
    int k = snprintf(line, sizeof(line), "   ");
    for (size_t j = i; j < n && j < i + 16; j++) k += snprintf(line + k, sizeof(line) - k, " %u,", p[j]);
    emit(line);
  }
  emit("};");
}

void exportDefaults(void (*emit)(const char*)) {
  char line[160];
  int ng = 0, nc = 0;
  for (int i = 0; i < wand::kMaxGestures; i++) ng += gestures[i].count > 0;
  for (int i = 0; i < IR_MAX_CODES; i++) nc += codes[i].khz > 0;

  emit("// ===== BEGIN default_spells.h (copy from the next line) =====");
  emit("// default_spells.h — generated by the wand's EXPORT command.");
  emit("// Loaded on first boot and after a factory reset.");
  emit("#pragma once");
  snprintf(line, sizeof(line), "#define DEFAULT_GESTURES %d", ng);
  emit(line);
  snprintf(line, sizeof(line), "#define DEFAULT_CODES %d", nc);
  emit(line);
  int k = snprintf(line, sizeof(line), "static const uint8_t kDefaultBind[8] = {");
  for (int i = 0; i < wand::kMaxGestures; i++) k += snprintf(line + k, sizeof(line) - k, "%s%u", i ? ", " : "", settings.bind[i]);
  snprintf(line + k, sizeof(line) - k, "};");
  emit(line);

  char var[32];
  for (int i = 0; i < wand::kMaxGestures; i++) {
    if (!gestures[i].count) continue;
    snprintf(line, sizeof(line), "// gesture %d: \"%s\", %u samples", i, gestures[i].name, gestures[i].count);
    emit(line);
    snprintf(var, sizeof(var), "kDefGesture%d", i);
    emitBytes(emit, var, (const uint8_t*)&gestures[i], gestureBytes(gestures[i]));
  }
  for (int i = 0; i < IR_MAX_CODES; i++) {
    if (!codes[i].khz) continue;
    snprintf(line, sizeof(line), "// IR code %d: \"%s\", %u bits x%u", i, codes[i].name, codes[i].nbits, codes[i].repeats);
    emit(line);
    snprintf(var, sizeof(var), "kDefCode%d", i);
    emitBytes(emit, var, (const uint8_t*)&codes[i], codeBytes(codes[i]));
  }
  if (ng) {
    emit("static const DefaultItem kDefaultGestureList[] = {");
    for (int i = 0; i < wand::kMaxGestures; i++)
      if (gestures[i].count) {
        snprintf(line, sizeof(line), "    {%d, kDefGesture%d, sizeof(kDefGesture%d)},", i, i, i);
        emit(line);
      }
    emit("};");
  }
  if (nc) {
    emit("static const DefaultItem kDefaultCodeList[] = {");
    for (int i = 0; i < IR_MAX_CODES; i++)
      if (codes[i].khz) {
        snprintf(line, sizeof(line), "    {%d, kDefCode%d, sizeof(kDefCode%d)},", i, i, i);
        emit(line);
      }
    emit("};");
  }
  emit("// ===== END default_spells.h =====");
}

#if STORAGE_NVM3
// ======================================================================= NVM3
// Our keys live in the application range, well away from the BLE stack's.
static const uint32_t kKeySettings = 0x0A000;
static const uint32_t kKeyGesture = 0x0A100;  // + i*8 + chunk
static const uint32_t kKeyCode = 0x0A200;     // + i*8 + chunk
static const size_t kChunk = 700;             // below any NVM3 max object size
static const int kMaxChunks = 4;

const char* backendName() { return "nvm3"; }
size_t usedBytes() { return 0; }
size_t capacityBytes() { return 0; }

static bool writeBlob(uint32_t key, const void* data, size_t len) {
  const uint8_t* p = (const uint8_t*)data;
  int chunks = len ? (int)((len + kChunk - 1) / kChunk) : 0;
  for (int c = 0; c < kMaxChunks; c++) {
    if (c < chunks) {
      size_t n = (c == chunks - 1) ? len - c * kChunk : kChunk;
      Ecode_t e = nvm3_writeData(nvm3_defaultHandle, key + c, p + c * kChunk, n);
      if (e != ECODE_NVM3_OK) {
        err = e;
        return false;
      }
    } else {
      nvm3_deleteObject(nvm3_defaultHandle, key + c);  // ignore "not found"
    }
  }
  if (nvm3_repackNeeded(nvm3_defaultHandle)) nvm3_repack(nvm3_defaultHandle);
  return true;
}

static size_t readBlob(uint32_t key, void* data, size_t cap) {
  uint8_t* p = (uint8_t*)data;
  size_t total = 0;
  for (int c = 0; c < kMaxChunks; c++) {
    uint32_t type;
    size_t n;
    if (nvm3_getObjectInfo(nvm3_defaultHandle, key + c, &type, &n) != ECODE_NVM3_OK) break;
    if (total + n > cap) break;
    if (nvm3_readData(nvm3_defaultHandle, key + c, p + total, n) != ECODE_NVM3_OK) break;
    total += n;
  }
  return total;
}

void begin() {
  // NVM3 is opened by the Silicon Labs core at startup (nvm3_initDefault is
  // not exported to sketches), so we just use nvm3_defaultHandle.
  memset(gestures, 0, sizeof(gestures));
  memset(codes, 0, sizeof(codes));
  bool fresh = false;
  if (readBlob(kKeySettings, &settings, sizeof(settings)) != sizeof(settings) || settings.magic != kMagic ||
      settings.version != kVersion) {
    defaults();
    saveSettings();
    fresh = true;
  }
  for (int i = 0; i < wand::kMaxGestures; i++) {
    size_t n = readBlob(kKeyGesture + i * 8, &gestures[i], sizeof(wand::GestureSlot));
    if (n < offsetof(wand::GestureSlot, samples) || gestureBytes(gestures[i]) != n)
      memset(&gestures[i], 0, sizeof(wand::GestureSlot));
  }
  for (int i = 0; i < IR_MAX_CODES; i++) {
    size_t n = readBlob(kKeyCode + i * 8, &codes[i], sizeof(IrCode));
    if (n != sizeof(IrCode) || !codeValid(codes[i])) memset(&codes[i], 0, sizeof(IrCode));
  }
  if (fresh) factoryReset();  // first boot: install default_spells.h
}

bool saveSettings() { return writeBlob(kKeySettings, &settings, sizeof(settings)); }
bool saveGesture(int i) {
  return writeBlob(kKeyGesture + i * 8, &gestures[i], gestures[i].count ? gestureBytes(gestures[i]) : 0);
}
bool saveCode(int i) { return writeBlob(kKeyCode + i * 8, &codes[i], codes[i].khz ? codeBytes(codes[i]) : 0); }

void factoryReset() {
  defaults();
  memset(gestures, 0, sizeof(gestures));
  memset(codes, 0, sizeof(codes));
  loadFactoryContent();
  saveSettings();
  for (int i = 0; i < wand::kMaxGestures; i++) saveGesture(i);
  for (int i = 0; i < IR_MAX_CODES; i++) saveCode(i);
}

#else
// ======================================================================= EEPROM
// Packed blob: [magic u32][len u16] then Settings, then per gesture
// [u16 len][bytes], then per code [u16 len][bytes]. Rewritten on every save,
// but EEPROM.update() only touches bytes that changed.
const char* backendName() { return "eeprom"; }

static const uint32_t kBlobMagic = 0x57424C42;  // "WBLB"
static uint8_t blob[16384];

size_t capacityBytes() {
  size_t cap = EEPROM.length();
  return cap > sizeof(blob) ? sizeof(blob) : cap;
}

size_t usedBytes() {
  size_t n = 6 + 2 + sizeof(settings);
  for (int i = 0; i < wand::kMaxGestures; i++) n += 2 + (gestures[i].count ? gestureBytes(gestures[i]) : 0);
  for (int i = 0; i < IR_MAX_CODES; i++) n += 2 + (codes[i].khz ? codeBytes(codes[i]) : 0);
  return n;
}

static bool saveAll() {
  size_t cap = capacityBytes();
  size_t n = 6;
  auto put = [&](const void* p, size_t len) {
    if (n + 2 + len > cap) return false;
    blob[n] = len & 0xFF;
    blob[n + 1] = len >> 8;
    memcpy(blob + n + 2, p, len);
    n += 2 + len;
    return true;
  };
  bool ok = put(&settings, sizeof(settings));
  for (int i = 0; ok && i < wand::kMaxGestures; i++) ok = put(&gestures[i], gestures[i].count ? gestureBytes(gestures[i]) : 0);
  for (int i = 0; ok && i < IR_MAX_CODES; i++) ok = put(&codes[i], codes[i].khz ? codeBytes(codes[i]) : 0);
  if (!ok) {
    err = 1;  // storage full
    return false;
  }
  memcpy(blob, &kBlobMagic, 4);
  blob[4] = n & 0xFF;
  blob[5] = n >> 8;
  for (size_t i = 0; i < n; i++) EEPROM.update(i, blob[i]);
  return true;
}

void begin() {
  memset(gestures, 0, sizeof(gestures));
  memset(codes, 0, sizeof(codes));
  defaults();
  uint32_t magic = 0;
  EEPROM.get(0, magic);
  size_t total = EEPROM.read(4) | (EEPROM.read(5) << 8);
  if (magic != kBlobMagic || total > EEPROM.length()) {
    loadFactoryContent();  // first boot: install default_spells.h
    saveAll();
    return;
  }
  size_t n = 6;
  auto get = [&](void* p, size_t cap) -> size_t {
    size_t len = EEPROM.read(n) | (EEPROM.read(n + 1) << 8);
    n += 2;
    for (size_t i = 0; i < len && i < cap; i++) ((uint8_t*)p)[i] = EEPROM.read(n + i);
    n += len;
    return len;
  };
  Settings s;
  memset(&s, 0, sizeof(s));
  size_t slen = get(&s, sizeof(s));
  // Also accept settings saved before `name` existed (shorter struct).
  bool ok = (slen == sizeof(s) || slen == offsetof(Settings, name)) && s.magic == kMagic;
  if (slen != sizeof(s)) memset(s.name, 0, sizeof(s.name));
  s.name[sizeof(s.name) - 1] = 0;
  bool oldCodes = ok && s.version < kVersion;  // IR codes in the old raw format
  if (ok && s.version <= kVersion) {
    settings = s;
    settings.version = kVersion;
  }
  for (int i = 0; i < wand::kMaxGestures; i++) get(&gestures[i], sizeof(wand::GestureSlot));
  for (int i = 0; i < IR_MAX_CODES; i++) {
    size_t len = get(&codes[i], sizeof(IrCode));
    if (oldCodes || len != sizeof(IrCode) || !codeValid(codes[i])) memset(&codes[i], 0, sizeof(IrCode));
  }
  if (oldCodes) {  // keep spells and settings, drop old-format codes and their bindings
    memset(settings.bind, kNoBinding, sizeof(settings.bind));
    saveAll();
  }
}

bool saveSettings() { return saveAll(); }
bool saveGesture(int) { return saveAll(); }
bool saveCode(int) { return saveAll(); }

void factoryReset() {
  defaults();
  memset(gestures, 0, sizeof(gestures));
  memset(codes, 0, sizeof(codes));
  loadFactoryContent();
  saveAll();
}
#endif

}  // namespace storage
